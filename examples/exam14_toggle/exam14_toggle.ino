#include <makerEdu_lib.h>

/*******************************************************************************************************************************
  toggle키 사용하기
********************************************************************************************************************************
  본 예제코드는 아두이노에서 하나의 스위치로 두가지 상태를 표현하는 toggle 예제입니다.
  스위치는 기본적으로 pinMode예제에서 보았듯이 누른상태와 누르지 않은 상태에 각각 원하는 디지털 값을 할당하여 표현하는데
  toggle방식은 하나의 스위치를 누를때마다 서로 다른 상태값을 가지게 하는 방식입니다.
  pinMode를 통해 디지털핀을 기본으로 설정된 출력모드에서 입력모드로 바꾸고, 아날로그 핀을 기본으로 설정된 입력모드에서 출력모드로
  바꾸어 사용하도록 합니다.
  다음 예제를 통해 사용법을 확인해 보세요
*********************************************************************************************************************************/
//////////////////////////////////////////////////////////////////////////////////////////////////////////////////////////////////
void setup()
{ // put your setup code here, to run once:
  start();                       // 고정핀 셋업(D2 ~ D13의 디지털핀 출력으로 셋업, A0~A5의 아날로그핀 입력으로 셋업멜로디연주속도 4)
  start_servo(0);                // 사용할 서보모터 개수 초기화
  start_ultraSonic(OFF, 7, 8);   // 초음파센서 초기화 (사용유무, trig핀번호, echo핀번호)
  start_led(13, 4);              // 사용할 RGBled 개수와 연결핀 초기화 (연결핀 - D13, 기본사용개수 4개)

  /**********pinMode는 반드시 설정함수를 먼저 호출한 후 그 다음에 호출한다.***************************/
  pinMode(A0, OUTPUT);        // 아날로그 A0핀 출력으로 설정
  pinMode(7, INPUT);          // 디지털 7핀 입력으로 설정
  delay(1000);
}

void loop()
{ // put your main code here, to run repeatedly:
  /////////////////////////////////////////////////////////////////////////////////////////////////////////////////////////////////
  int flag = 0;                               // 토글키를 위한 플래그변수 설정 초기값은 0

  while (1)                                   // 무한 반복
  { // 중괄호 시작부터
    while (flag == 0)                         // flag변수값이 0이라면 계속 반복
    { // 중괄호 시작부터
      if (digitalRead(7) == 0)                // flag변수값이 0이고 디지털 7번핀이 거짓이면
      {
        digitalWrite(A0, HIGH);               // A0핀에 HIGH값 출력
        flag = 1;                             // flag를 1로 변경함
        delay(300);                           // 체터링 제거를 위한 지연시간
      }
    }
    while (flag == 1)                         // flag변수값이 1이라면 계속 반복할거야
    { // 중괄호 시작부터
      if (digitalRead(7) == 0)
      {
        digitalWrite(A0, LOW);
        flag = 0;                              // flag를 0으로 초기화
        delay(300);                            // 체터링 제거를 위한 지연시간
      }
    }                                          // flag변수값이 1일때 반복되는 중괄호 마침
  }                                            // 무한반복 중괄호 마침


  ////////////////////////////////////////////////////////////////////////////////////////////////////////////////////////////////
  finish();
}
